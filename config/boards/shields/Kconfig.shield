## config/boards/shields/Kconfig.shield
```kconfig
config SHIELD_VERDANSK_LEFT
    def_bool $(shields_list_contains,verdansk_left)

config SHIELD_VERDANSK_RIGHT
    def_bool $(shields_list_contains,verdansk_right)
```

## config/boards/shields/verdansk/Kconfig.defconfig
```kconfig
if SHIELD_VERDANSK_LEFT

config ZMK_KEYBOARD_NAME
    default "verdansk"

config ZMK_SPLIT_ROLE_CENTRAL
    default y

endif

if SHIELD_VERDANSK_LEFT || SHIELD_VERDANSK_RIGHT

config ZMK_SPLIT
    default y

endif
```
